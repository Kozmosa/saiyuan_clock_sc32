/**
 *****************************************************************************************************
  * @copyright	(c)  Shenzhen Saiyuan Microelectronics Co., Ltd
  * @file	         SysFunVarDefine.c
  * @author	 
  * @version 	
  * @date	
  * @brief	         Store var control and function control define
  * @details         
 *****************************************************************************************************
 * @attention
 *
 *****************************************************************************************************
 */
#include "SC_Init.h"
#include "SC_it.h"
#include "..\Drivers\SCDriver_list.h"
#include "HeadFiles\SysFunVarDefine.h"
#include "OLEDFONT.h"
//**********************************************************************
/**************************************Generated by EasyCodeCube*************************************/
//Forbid editing areas between the labels !!!
volatile unsigned char TWI0Flag = 0;
unsigned char TWI0SendData = 0;
unsigned char US0_UART_ReceiveData = 0;
 void delay(uint16_t cnt)
{
    /*<UserCodeStart>*//*<SinOne-Tag><65>*/
    while(cnt--);
    
    /*<UserCodeEnd>*//*<SinOne-Tag><65>*/
}
////清屏
 void OLED_Clear(void)
{
    /*<UserCodeStart>*//*<SinOne-Tag><66>*/
    uint8_t i,n;
    for(i=0;i<8;i++)  
    {  
        OLED_WR_Byte (0xb0+i,OLED_CMD);    
        OLED_WR_Byte (0x00,OLED_CMD);      
        OLED_WR_Byte (0x10,OLED_CMD);     
        for (n=0;n<128;n++)
        {
            OLED_WR_Byte(0,OLED_DATA); 
        }
    }
    
    /*<UserCodeEnd>*//*<SinOne-Tag><66>*/
}
////OLED屏幕背景正常/反色显示
 void OLED_ColorTurn(uint8_t ColorValue)
{
    /*<UserCodeStart>*//*<SinOne-Tag><67>*/
    if (ColorValue==0)
     {
         OLED_WR_Byte(0xA6,OLED_CMD);
     }
     if (ColorValue==1)
     {
         OLED_WR_Byte(0xA7,OLED_CMD);
     }
    
    /*<UserCodeEnd>*//*<SinOne-Tag><67>*/
}
////OLED显示关闭
 void OLED_Display_Off(void)
{
    /*<UserCodeStart>*//*<SinOne-Tag><69>*/
    OLED_WR_Byte(0X8D,OLED_CMD);
    OLED_WR_Byte(0X10,OLED_CMD);
    OLED_WR_Byte(0XAE,OLED_CMD);
    
    /*<UserCodeEnd>*//*<SinOne-Tag><69>*/
}
////OLED显示打开
 void OLED_Display_On(void)
{
    /*<UserCodeStart>*//*<SinOne-Tag><70>*/
    OLED_WR_Byte(0X8D,OLED_CMD);
     OLED_WR_Byte(0X14,OLED_CMD);
     OLED_WR_Byte(0XAF,OLED_CMD);
    
    /*<UserCodeEnd>*//*<SinOne-Tag><70>*/
}
////OLED屏幕背景正常/反转显示
 void OLED_DisplayTurn(uint8_t TurnValue)
{
    /*<UserCodeStart>*//*<SinOne-Tag><71>*/
     if (TurnValue==0)
     {
         OLED_WR_Byte(0xC8,OLED_CMD);
         OLED_WR_Byte(0xA1,OLED_CMD);
     }
     if(TurnValue==1)
     {
         OLED_WR_Byte(0xC0,OLED_CMD);
         OLED_WR_Byte(0xA0,OLED_CMD);
     }
    
    /*<UserCodeEnd>*//*<SinOne-Tag><71>*/
}
////初始化OLED配置
 void OLED_Init(void)
{
    /*<UserCodeStart>*//*<SinOne-Tag><72>*/
     OLED_WR_Byte(0xAE,OLED_CMD);
     OLED_WR_Byte(0x00,OLED_CMD);
     OLED_WR_Byte(0x10,OLED_CMD);
     OLED_WR_Byte(0x40,OLED_CMD);
     OLED_WR_Byte(0xb8,OLED_CMD);
     OLED_WR_Byte(0x81,OLED_CMD);
     OLED_WR_Byte(0xff,OLED_CMD);
     OLED_WR_Byte(0xa1,OLED_CMD);
     OLED_WR_Byte(0xa6,OLED_CMD);
     OLED_WR_Byte(0xa8,OLED_CMD);
     OLED_WR_Byte(0x3f,OLED_CMD);
     OLED_WR_Byte(0xc8,OLED_CMD);
     OLED_WR_Byte(0xd3,OLED_CMD);
     OLED_WR_Byte(0x00,OLED_CMD);
     OLED_WR_Byte(0xd5,OLED_CMD);
     OLED_WR_Byte(0x80,OLED_CMD);
     OLED_WR_Byte(0xd8,OLED_CMD);
     OLED_WR_Byte(0x05,OLED_CMD);
     OLED_WR_Byte(0xd9,OLED_CMD);
     OLED_WR_Byte(0xf1,OLED_CMD);
     OLED_WR_Byte(0xda,OLED_CMD);
     OLED_WR_Byte(0x12,OLED_CMD);
     OLED_WR_Byte(0xdb,OLED_CMD);
     OLED_WR_Byte(0x30,OLED_CMD);
     OLED_WR_Byte(0x8d,OLED_CMD);
     OLED_WR_Byte(0x14,OLED_CMD);
     OLED_WR_Byte(0xaf,OLED_CMD);
     OLED_Clear();
     OLED_WR_Byte(0xAF,OLED_CMD);
     OLED_ColorTurn(0);
     OLED_DisplayTurn(0);
     OLED_Display_Off();
     OLED_Display_On();
    
    /*<UserCodeEnd>*//*<SinOne-Tag><72>*/
}
////设置输入数据坐标x列：0~127  y行（页）：0~6
 void OLED_Set_Pos(uint8_t x,uint8_t y)
{
    /*<UserCodeStart>*//*<SinOne-Tag><73>*/
     OLED_WR_Byte(0xb0+y,OLED_CMD);
     OLED_WR_Byte(((x&0xf0)>>4)|0x10,OLED_CMD);
     OLED_WR_Byte((x&0x0f),OLED_CMD);
    
    /*<UserCodeEnd>*//*<SinOne-Tag><73>*/
}
/******************************************************************************************************
 *在指定位置显示一个字节数据，输入数据从高到低显示x列：0~127  y行（页）：0~6 input输入的
 *字节数据
 ******************************************************************************************************/
 void OLED_ShowByte(uint8_t x,uint8_t y,uint8_t input)
{
    /*<UserCodeStart>*//*<SinOne-Tag><74>*/
     unsigned char SwapValue = 0x00;
     int SwapNumber;
     for (SwapNumber=0;SwapNumber<8;SwapNumber++)
     {
         if(input & (0x01 << SwapNumber))
         SwapValue |= (0x80 >> SwapNumber);
     }
     OLED_Set_Pos(x,y);
     OLED_WR_Byte(SwapValue,OLED_DATA);
    
    /*<UserCodeEnd>*//*<SinOne-Tag><74>*/
}
////向OLED写入一个字节命令/数据dat，想要发送的一字节数据mode 0：命令  1:数据
 void OLED_WR_Byte(uint8_t dat,uint8_t mode)
{
    /*<UserCodeStart>*//*<SinOne-Tag><75>*/
     TWI_Start();
     TWI_SendByte(0x78);
     if (mode)
     {
         TWI_SendByte(0x40);
     }
     else
     {
         TWI_SendByte(0x00);
     }
     TWI_SendByte(dat);
     TWI_Stop();
    
    /*<UserCodeEnd>*//*<SinOne-Tag><75>*/
}
////发送一字节数据 SendByte：需要发送的数据
 void TWI_SendByte(uint8_t SendByte)
{
    /*<UserCodeStart>*//*<SinOne-Tag><78>*/
     TWI_SendData(TWI0,SendByte);
     while (!TWI0Flag);
     TWI0Flag = 0;
    
    /*<UserCodeEnd>*//*<SinOne-Tag><78>*/
}
////产生起始条件
 void TWI_Start(void)
{
    /*<UserCodeStart>*//*<SinOne-Tag><79>*/
    TWI_GenerateSTART(TWI0,ENABLE);
    while(!TWI0Flag);
    TWI0Flag = 0;
    delay(200); 
    
    /*<UserCodeEnd>*//*<SinOne-Tag><79>*/
}
////TWI主机模式停止位
 void TWI_Stop(void)
{
    /*<UserCodeStart>*//*<SinOne-Tag><80>*/
    TWI_GenerateSTOP(TWI0,ENABLE);
    delay(1300);
    
    /*<UserCodeEnd>*//*<SinOne-Tag><80>*/
}
/*************************************.Generated by EasyCodeCube.************************************/
